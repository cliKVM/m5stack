## firmware/main/Kconfig.projbuild
```kconfig
menu "clikVM"
choice CLIK_MODE
    prompt "Controller personality (one USB role at a time)"
    default CLIK_MODE_ANDROID_HOST
config CLIK_MODE_ANDROID_HOST
    bool "Android USB host: AOA HID then authorized ADB"
config CLIK_MODE_NETWORK
    bool "Network controller: voice and intents for the assigned target"
config CLIK_MODE_USB_HID
    bool "USB HID device: manual keyboard/mouse plus network controller"
endchoice
config CLIK_HID_SELF_POWERED
    bool "HID device is self-powered and has an external VBUS monitor"
    depends on CLIK_MODE_USB_HID
    default n
    help
        Default HID assumes PC bus power only. Battery or independent BUS power
        requires a verified 3.3V-safe VBUS monitor circuit and GPIO below.
config CLIK_HID_VBUS_GPIO
    int "External VBUS monitor GPIO (not USB D+/D-)"
    depends on CLIK_HID_SELF_POWERED
    range -1 48
    default -1
    help
        -1 means not configured and prevents USB startup. Select a free
        GPIO for the actual board and a qualified comparator/divider circuit.
choice CLIK_BOARD
    prompt "Target board"
    default CLIK_BOARD_CORES3
config CLIK_BOARD_CORES3
    bool "M5Stack CoreS3 K128"
config CLIK_BOARD_LCD154
    bool "Waveshare ESP32-S3-LCD-1.54 (33867 / Touch 33869)"
endchoice
config CLIK_LCD154_TOUCH
    bool "Waveshare Touch variant (CST816)"
    depends on CLIK_BOARD_LCD154
    default n
choice CLIK_CORES3_POWER_SOURCE
    prompt "CoreS3 host power source (see docs/hardware.md)"
    depends on CLIK_BOARD_CORES3 && CLIK_MODE_ANDROID_HOST
    default CLIK_CORES3_EXTERNAL_BUS_POWER
config CLIK_CORES3_EXTERNAL_BUS_POWER
    bool "External 5V BUS from DINBase DC supply"
config CLIK_CORES3_BATTERY_POWER
    bool "Internal battery boost, NO external BUS supply"
endchoice
config CLIK_ALLOW_HTTP_LAN
    bool "Development: allow unencrypted HTTP to a private LAN IPv4 address"
    default n
    help
        Production uses HTTPS with CA verification. This option permits only
        explicit RFC1918 IPv4 hosts for a local test gateway. DNS hostnames
        and public addresses still require HTTPS.
config CLIK_AUDIO_SECONDS
    int "Push-to-talk maximum recording seconds"
    range 1 15
    default 8
config CLIK_CAPTURE_MAX_MIB
    int "Maximum streamed screenshot bytes (MiB)"
    range 1 16
    default 4
config CLIK_TTS_ENABLED
    bool "Speak short results through explicitly configured gateway TTS"
    default n
endmenu
```

## firmware/sdkconfig.defaults
```kconfig
CONFIG_IDF_TARGET="esp32s3"
CONFIG_ESPTOOLPY_FLASHSIZE_16MB=y
CONFIG_SPIRAM=y
CONFIG_SPIRAM_MODE_OCT=y
CONFIG_SPIRAM_SPEED_80M=y
CONFIG_SPIRAM_USE_MALLOC=y
CONFIG_SPIRAM_MALLOC_ALWAYSINTERNAL=16384
CONFIG_SPIRAM_MALLOC_RESERVE_INTERNAL=65536
CONFIG_ESP_CONSOLE_UART_DEFAULT=y
CONFIG_ESP_CONSOLE_USB_SERIAL_JTAG=n
CONFIG_ESP_CONSOLE_SECONDARY_USB_SERIAL_JTAG=n
CONFIG_PARTITION_TABLE_CUSTOM=y
CONFIG_PARTITION_TABLE_CUSTOM_FILENAME="partitions.csv"
CONFIG_ESP_MAIN_TASK_STACK_SIZE=8192
CONFIG_FREERTOS_HZ=1000
CONFIG_MBEDTLS_CERTIFICATE_BUNDLE=y
CONFIG_MBEDTLS_CERTIFICATE_BUNDLE_DEFAULT_FULL=y
CONFIG_MBEDTLS_PEM_WRITE_C=y
CONFIG_MBEDTLS_PEM_PARSE_C=y
CONFIG_LWIP_SNTP_MAX_SERVERS=2
CONFIG_HTTPD_MAX_REQ_HDR_LEN=2048
CONFIG_HTTPD_MAX_URI_LEN=256
CONFIG_COMPILER_OPTIMIZATION_PERF=y
```
